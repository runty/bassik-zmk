## boards/arm/bassik/Kconfig.board
```kconfig
# Le Chiffre (stm32) board configuration

# Copyright (c) 2020 The ZMK Contributors
# SPDX-License-Identifier: MIT

config BOARD_BASSIK
    bool "Bassik"
    depends on SOC_STM32F072XB
```
